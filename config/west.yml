## config/west.yml
```yaml
manifest:
  remotes:
    - name: zmkfirmware
      url-base: https://github.com/zmkfirmware
  projects:
    - name: zmk
      remote: zmkfirmware
      # 锁定稳定版v0.17.1，避免main分支的结构变更问题
      revision: v0.17.1
      path: zmk
  self:
    path: config
```
